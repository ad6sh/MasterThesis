## RIOT/2022-raghoothaman-adarsh/Src/doriot_cert_chain_discovery_v01/doriot_wot/doriot_wot_cl/Kconfig
```kconfig
menuconfig KCONFIG_WOT_CL
    bool "Configure Doriot WoT client"
    default y
    help
        This will enable configuring the WoT client	

if KCONFIG_WOT_CL

config WOT_CL_COMMON_NAME
    string "name of the client"
    default "alice"    

config WOT_CLIENT_CERT_URI
    string "coap uri for handling client certificate"
    default "/cli/cert"
    
config WOT_RD_CERT_URI
    string "coap uri for handling rd certificate"
    default "/rd/cert"

config GCOAP_PORT
    int "coap port for communicating with resource directory"
    default 5684    

endif #KCONFIG_WOT_CL
```

## RIOT/2022-raghoothaman-adarsh/Src/doriot_cert_chain_discovery_v01/doriot_wot/doriot_wot_rd/Kconfig
```kconfig
menuconfig KCONFIG_WOT_RD
    bool "Configure Doriot WoT Resource directory"
    default y
    help
        This will enable configuring the WoT Resource directory 	

if KCONFIG_WOT_RD

config WOT_RD_COMMON_NAME
    string "name of the resource directory"
    default "rd1cn_km"    

config WOT_CLIENT_CERT_URI
    string "coap uri for handling client certificate"
    default "/cli/cert"
    
config WOT_RD_CERT_URI
    string "coap uri for handling rd certificate"
    default "/rd/cert"

config GCOAP_PORT
    int "coap port for communicating with resource directory"
    default 5684    

endif #KCONFIG_WOT_RD
```

## RIOT/2022-raghoothaman-adarsh/Src/doriot_cert_chain_discovery_v01/examples/client/Kconfig
```kconfig
menuconfig KCONFIG_WOT_CLIENT_APP
    bool "Configure Doriot WoT client App"
    default y
    help
        This will enable configuring the WoT client App"	

if KCONFIG_WOT_CLIENT_APP

config WOT_CL_COMMON_NAME
    string "name of the client"
    default "alice"
	
config WOT_CLIENT_CERT_URI
    string "coap uri for handling client certificate"
    default "/cli/cert"
    
config WOT_RD_CERT_URI
    string "coap uri for handling rd certificate"
    default "/rd/cert"

config GCOAP_PORT
    int "coap port for communicating with resource directory"
    default 5684    

endif #KCONFIG_WOT_CLIENT_APP
```

## RIOT/2022-raghoothaman-adarsh/Src/doriot_cert_chain_discovery_v01/examples/rd/Kconfig
```kconfig
menuconfig KCONFIG_WOT_RD_APP
    bool "Configure Doriot WoT RD App"
    default y
    help
        This will enable configuring the WoT RD App"	

if KCONFIG_WOT_RD_APP

config WOT_RD_COMMON_NAME
    string "name of the resource directory"
    default "rd1cn"

config WOT_CLIENT_CERT_URI
    string "coap uri for handling client certificate"
    default "/cli/cert"
    
config WOT_RD_CERT_URI
    string "coap uri for handling rd certificate"
    default "/rd/cert"

config GCOAP_PORT
    int "coap port for communicating with resource directory"
    default 5684   

endif #KCONFIG_WOT_RD_APP
```

## RIOT/2022-raghoothaman-adarsh/Src/doriot_cert_chain_discovery_v02/examples/rd/Kconfig
```kconfig
menuconfig KCONFIG_WOT_RD_APP
    bool "Configure Doriot WoT RD App"
    default y
    help
        This will enable configuring the WoT RD App"	

if KCONFIG_WOT_RD_APP

config WOT_RD_COMMON_NAME
    string "name of the resource directory"
    default "rd1cn"

config WOT_CLIENT_CERT_URI
    string "coap uri for handling client certificate"
    default "/cl/cert"
    
config WOT_RD_CERT_URI
    string "coap uri for handling rd certificate"
    default "/rd/cert"

config GCOAP_PORT
    int "coap port for communicating with resource directory"
    default 5683

config WOT_AUTH_TYPE
    int "authentication between client and rd;0:PSK,1:ROOT,2:OOB"
    default 0

endif #KCONFIG_WOT_RD_APP
```

## RIOT/2022-raghoothaman-adarsh/Src/doriot_cert_chain_discovery_v03/examples/client/Kconfig
```kconfig
menuconfig KCONFIG_WOT_CLIENT_APP
    bool "Configure Doriot WoT client App"
    default y
    help
        This will enable configuring the WoT client App"	

if KCONFIG_WOT_CLIENT_APP

config WOT_CL_COMMON_NAME
    string "name of the client"
    default "alice"
	
config WOT_CLIENT_CERT_URI
    string "coap uri for handling client certificate"
    default "/cl/cert"
    
config WOT_RD_CERT_URI
    string "coap uri for handling rd certificate"
    default "/rd/cert"

config GCOAP_PORT
    int "coap port for communicating with resource directory"
    default 5683 

config WOT_AUTH_TYPE
    int "authentication between client and rd;0:PSK,1:ROOT,2:OOB"
    default 0

config WOT_STORE_LOOKUP_CERT
    bool "store lookup certificates in the list"
    default y

config WOT_USE_CRYPTO_CELL
    bool "use hardware accelerators for crypto"
    default n

endif #KCONFIG_WOT_CLIENT_APP
```

## RIOT/WoT/doriot_cl_rd_registration/examples/client/Kconfig
```kconfig
menuconfig KCONFIG_WOT_CLIENT_APP
    bool "Configure Doriot WoT client App"
    default y
    help
        This will enable configuring the WoT client App"	

if KCONFIG_WOT_CLIENT_APP

config WOT_CL_COMMON_NAME
    string "name of the client"
    default "alice"
	
config WOT_CLIENT_CERT_URI
    string "coap uri for handling client certificate"
    default "/cl/cert"
    
config WOT_RD_CERT_URI
    string "coap uri for handling rd certificate"
    default "/rd/cert"

config GCOAP_PORT
    int "coap port for communicating with resource directory"
    default 5683    

config WOT_AUTH_TYPE
    int "authentication between client and rd;0:PSK,1:ROOT,2:OOB"
    default 0  

endif #KCONFIG_WOT_CLIENT_APP
```

## RIOT/WoT/old/doriot_certificate_discovery/doriot_wot/doriot_wot_rd/Kconfig.bak
```kconfig
menuconfig KCONFIG_WOT_RD
    bool "Configure Doriot WoT Resource directory"
    default y
    help
        This will enable configuring the WoT Resource directory 	

if KCONFIG_WOT_RD

config WOT_RD_COMMON_NAME
    string "name of the resource directory"
    default "rd1cn_k"

endif #KCONFIG_WOT_RD
```

## RIOT/WoT/old/doriot_certificate_discovery/examples/client/Kconfig.bak
```kconfig
menuconfig KCONFIG_WOT_CLIENT_APP
    bool "Configure Doriot WoT client App"
    default y
    help
        This will enable configuring the WoT client App"	

if KCONFIG_WOT_CLIENT_APP

config WOT_CL_COMMON_NAME
    string "name of the client"
    default "alice"

endif #KCONFIG_WOT_CLIENT_APP
```

## RIOT/WoT/old/doriot_certificate_discovery/examples/rd/Kconfig.bak
```kconfig
menuconfig KCONFIG_WOT_RD_APP
    bool "Configure Doriot WoT RD App"
    default y
    help
        This will enable configuring the WoT RD App"	

if KCONFIG_WOT_RD_APP

config WOT_RD_COMMON_NAME
    string "name of the resource directory"
    default "rd1cn_ka"

endif #KCONFIG_WOT_RD_APP
```

## doriot_certificate_chain_discovery/doriot_wot/doriot_wot_cl/Kconfig
```kconfig
menuconfig KCONFIG_WOT_CL
    bool "Configure Doriot WoT client"
    default y
    help
        This will enable configuring the WoT client	

if KCONFIG_WOT_CL

config WOT_CL_COMMON_NAME
    string "name of the client"
    default "alice"

config WOT_CLIENT_CERT_URI
    string "coap uri for handling client certificate during registration"
    default "/cl/cert"
    
config WOT_RD_CERT_URI
    string "coap uri for handling rd certificate during registration"
    default "/rd/cert"

config WOT_LOOKUP_CERT_URI
    string "coap uri for handling certificate during lookup"
    default "/lookup/cert"

config GCOAP_PORT
    int "coap port for communicating with resource directory"
    default 5683

config WOT_AUTH_TYPE
    int "authentication between client and rd;0:PSK,1:ROOT,2:OOB"
    default 0

config WOT_STORE_LOOKUP_CERT
    bool "store lookup certificates in the list"
    default y

config WOT_USE_CRYPTO_CELL
    bool "use hardware accelerators for crypto"
    default y



endif #KCONFIG_WOT_CL
```

## doriot_certificate_chain_discovery/doriot_wot/doriot_wot_rd/Kconfig
```kconfig
menuconfig KCONFIG_WOT_RD
    bool "Configure Doriot WoT Resource directory"
    default y
    help
        This will enable configuring the WoT Resource directory 	

if KCONFIG_WOT_RD

config WOT_RD_COMMON_NAME
    string "name of the resource directory"
    default "rd1cn_km" 

config WOT_CLIENT_CERT_URI
    string "coap uri for handling client certificate during registration"
    default "/cl/cert"
    
config WOT_RD_CERT_URI
    string "coap uri for handling rd certificate during registration"
    default "/rd/cert"

config WOT_LOOKUP_CERT_URI
    string "coap uri for handling  certificate during lookup"
    default "/lookup/cert"

config GCOAP_PORT
    int "coap port for communicating with resource directory"
    default 5683

config WOT_AUTH_TYPE
    int "authentication between client and rd;0:PSK,1:ROOT,2:OOB"
    default 0

config WOT_USE_CRYPTO_CELL
    bool "use hardware accelerators for crypto"
    default n

endif #KCONFIG_WOT_RD
```
